## configs/qemu_riscv64_virt_min_defconfig
```kconfig
# Architecture
BR2_riscv=y
BR2_RISCV_64=y

# System
BR2_SYSTEM_DHCP="eth0"
BR2_TARGET_GENERIC_GETTY=y

# Filesystem
BR2_TARGET_ROOTFS_EXT2=y

#salus configs
BR2_TARGET_GENERIC_ROOT_PASSWD="root"
BR2_PACKAGE_DROPBEAR=y
BR2_TARGET_ROOTFS_EXT2_SIZE="64M"

BR2_PACKAGE_QEMU_ARCH_SUPPORTS_TARGET=n

BR2_PACKAGE_PYTHON3=y
```
